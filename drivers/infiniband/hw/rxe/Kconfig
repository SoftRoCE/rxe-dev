## drivers/infiniband/hw/rxe/Kconfig
```kconfig
config INFINIBAND_RXE
	tristate "Software RDMA over Ethernet (RoCE) driver"
	depends on INET && PCI && INFINIBAND
	---help---
	This driver implements the InfiniBand RDMA transport over
	the Linux network stack. It enables a system with a
	standard Ethernet adapter to interoperate with a RoCE
	adapter or with another system running the RXE driver.
	Documentation on InfiniBand and RoCE can be downloaded at
	www.infinibandta.org and www.openfabrics.org. (See also
	siw which is a similar software driver for iWARP.)

	The driver is split into two layers, one interfaces with the
	Linux RDMA stack and implements a kernel or user space
	verbs API. The user space verbs API requires a support
	library named librxe which is loaded by the generic user
	space verbs API, libibverbs. The other layer interfaces
	with the Linux network stack at layer 3.

	There are three kernel modules provided with RXE.

	ib_rxe		- attaches to the Linux RDMA stack
	ib_rxe_net	- attaches to the Linux network stack

	Rxe_cfg provided with librxe is a configuration tool that
	loads and unloads the ib_rxe and ib_rxe_net kernel modules
```
